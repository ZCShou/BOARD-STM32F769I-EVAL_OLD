## build_tools/buildroot-2023.02.5/configs/stm32f769_eval_sd_defconfig
```kconfig
BR2_arm=y
BR2_cortex_m7=y
#
# Rootfs
#
BR2_ROOTFS_POST_BUILD_SCRIPT="board/stmicroelectronics/common/stm32f7xx/stm32-post-build.sh board/stmicroelectronics/stm32f769-eval/post-build.sh"
BR2_ROOTFS_POST_IMAGE_SCRIPT="support/scripts/genimage.sh"
BR2_ROOTFS_POST_SCRIPT_ARGS="-c board/stmicroelectronics/stm32f769-eval/genimage.cfg"
#
# Linux Kernel
#
BR2_LINUX_KERNEL=y
BR2_LINUX_KERNEL_CUSTOM_VERSION=y
BR2_LINUX_KERNEL_CUSTOM_VERSION_VALUE="5.15.52"
BR2_LINUX_KERNEL_DEFCONFIG="stm32f769"
BR2_LINUX_KERNEL_CONFIG_FRAGMENT_FILES="$(LINUX_DIR)/arch/arm/configs/dram_0xc0000000.config board/stmicroelectronics/stm32f769-eval/linux-sd.fragment"
BR2_LINUX_KERNEL_IMAGE_TARGET_CUSTOM=y
BR2_LINUX_KERNEL_IMAGE_TARGET_NAME="zImage"
BR2_LINUX_KERNEL_DTS_SUPPORT=y
BR2_LINUX_KERNEL_INTREE_DTS_NAME="stm32f769-eval"
#
# Bootloader
#

#
# Toolchain
#
BR2_TOOLCHAIN=y
BR2_TOOLCHAIN_USES_UCLIBC=y
BR2_TOOLCHAIN_BUILDROOT=y
# Toolchain Buildroot Options
BR2_TOOLCHAIN_BUILDROOT_VENDOR="zcs"
BR2_TOOLCHAIN_BUILDROOT_UCLIBC=y
BR2_TOOLCHAIN_BUILDROOT_LIBC="uclibc"
#
# Package
#
BR2_PACKAGE_BUSYBOX_CONFIG="package/busybox/busybox-minimal.config"
BR2_PACKAGE_HOST_LINUX_HEADERS_CUSTOM_5_15=y
BR2_PACKAGE_HOST_DOSFSTOOLS=y
BR2_PACKAGE_HOST_GENIMAGE=y
BR2_PACKAGE_HOST_MTOOLS=y
BR2_PACKAGE_HOST_OPENOCD=y

#
# Target
#
BR2_TARGET_GENERIC_HOSTNAME="LinuxSTM32"
BR2_TARGET_GENERIC_ISSUE="Welcome to LinuxSTM32"
BR2_TARGET_GENERIC_ROOT_PASSWD="123456"
BR2_TARGET_ROOTFS_EXT4=y
BR2_TARGET_ROOTFS_EXT4_SIZE="32M"
BR2_TARGET_UBOOT=y
BR2_TARGET_UBOOT_BUILD_SYSTEM_KCONFIG=y
BR2_TARGET_UBOOT_CUSTOM_VERSION=y
BR2_TARGET_UBOOT_CUSTOM_VERSION_VALUE="2022.10"
BR2_TARGET_UBOOT_BOARD_DEFCONFIG="stm32f769-eval"
BR2_TARGET_UBOOT_NEEDS_OPENSSL=y
```

## build_tools/buildroot-2023.02.5/configs/stm32f769_eval_xip_defconfig
```kconfig
BR2_arm=y
BR2_cortex_m7=y
BR2_ENABLE_LTO=y
#
# Rootfs
#
BR2_ROOTFS_POST_BUILD_SCRIPT="board/stmicroelectronics/common/stm32f7xx/stm32-post-build.sh"
#
# Linux Kernel
#
BR2_KERNEL_HEADERS_5_15=y
BR2_LINUX_KERNEL=y
BR2_LINUX_KERNEL_CUSTOM_VERSION=y
BR2_LINUX_KERNEL_CUSTOM_VERSION_VALUE="5.15.52"
BR2_LINUX_KERNEL_USE_CUSTOM_CONFIG=y
BR2_LINUX_KERNEL_CUSTOM_CONFIG_FILE="board/stmicroelectronics/stm32f769-eval/linux-xip.config"
BR2_LINUX_KERNEL_IMAGE_TARGET_CUSTOM=y
BR2_LINUX_KERNEL_IMAGE_TARGET_NAME="xipImage"
BR2_LINUX_KERNEL_DTS_SUPPORT=y
BR2_LINUX_KERNEL_INTREE_DTS_NAME="stm32f769-eval"
#
# Package
#
BR2_PACKAGE_BUSYBOX_CONFIG="package/busybox/busybox-minimal.config"
BR2_PACKAGE_HOST_OPENOCD=y
#
# Target
#
BR2_TARGET_ROOTFS_INITRAMFS=y
BR2_TARGET_AFBOOT_STM32=y
BR2_TARGET_AFBOOT_STM32_KERNEL_ADDR=0x0800C000
```

## u-boot-2022.10/board/st/stm32f769-eval/Kconfig
```kconfig
if TARGET_STM32F769_EVAL

config SYS_BOARD
	string
	default "stm32f769-eval"

config SYS_VENDOR
	string
	default "st"

config SYS_SOC
	string
	default "stm32f7"

config SYS_CONFIG_NAME
	string
	default "stm32f769-eval"

endif
```

## u-boot-v2022.10/arch/arm/mach-stm32/stm32f7/Kconfig
```kconfig
if STM32F7

config TARGET_STM32F746_DISCO
	bool "STM32F746 Discovery board"

source "board/st/stm32f746-disco/Kconfig"

config TARGET_STM32F769_EVAL
	bool "STM32F769 Evaluation board"

source "board/st/stm32f769-eval/Kconfig"

endif
```
